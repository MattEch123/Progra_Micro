
/*******************************************************/
; Universidad del Valle de Guatemala
; IE2023: Programación de Microcontroladores
; Lab3.asm
;
; Created: 2/19/2025 4:00:23 PM
; Author : Matheo
; Hardware ATMega 328P

.include "M328PDEF.inc"  ; Incluir definiciones de ATmega328P

.cseg
.org 0x0000
    JMP START

.org 0x0006   ; Dirección del vector de interrupción PCINT0
    JMP PCINT0_ISR

.org 0x0020   ; Dirección del vector de interrupción Timer0 Overflow
    JMP TIMR0_ISR

.def DISPLAY = R21
.def DISPLAY2 = R22


// Configuración de la pila
START:
	LDI     R16, LOW(RAMEND)
	OUT     SPL, R16
	LDI     R16, HIGH(RAMEND)
	OUT     SPH, R16

SETUP:
	// DESHABILITAR INTERRUPCIONES GLOBALES (BORRA BIT 1 EN SREG)
	// NO QUIERO SER INTERRUMPIDO EN SETUP
	CLI

	//	CONFIGURA EL CLOCK GENERAL CON UN PRESCALER DE 16 (1MHz)
	LDI R16, (1 << CLKPCE)
	STS CLKPR, R16 // Habilitar cambio de PRESCALER
	LDI R16, 0b00000100
	STS CLKPR, R16 // Configurar Prescaler a 16 F_cpu = 1MHz

	//HABILITAR INTERRUPCIONES EN PCINT0
	LDI		R16, (1 << PCIE0)
	STS		PCICR, R16			//HABILITAR INTERRUPCIONES EN PORTB

	LDI		R16, (1 << PCINT0) | (1 << PCINT1)
	STS		PCMSK0, R16			// HABILITAR INTERRUPCIONES EN PINES 0 Y 1 DE PORTB

	// INICIALIZAR TIMER0 
	LDI		R16, (1 << CS01) | (1 << CS00)	// CONFIGURAR PRESCALER EN 64
	OUT		TCCR0B, R16
	LDI		R16, 178	// CARGAR VALOR INICIAL DE TCNT0
	OUT		TCNT0, R16

	// HABILITAR INTERRUPCIONES TOV0
	LDI		R16, (1 << TOIE0)
	STS		TIMSK0, R16


	// Configurar PORTC como salida (para mostrar el contador en LEDs)
    LDI     R16, 0xFF
    OUT     DDRC, R16  // PORTC como salida

	// Configurar PORTD como salida (para mostrar display de 7 segmentos)
    LDI     R16, 0xFF
    OUT     DDRD, R16  ; PORTD como salida
	
	// Configurar PORTB como entrada con pull-ups activados
    LDI     R16, 0x00
    OUT     DDRB, R16	// PORTB como entrada
    LDI     R16, 0xFF
    OUT     PORTB, R16	// Activar pull-ups

	//GUARDAR EN REGISTROS DE LA SRAM LAS COMBINACIONES PARA EL CONTADOR
	LDI     XH, 0x01  // PUNTERO X HACIA 0x0100
	LDI     XL, 0x00  


	LDI		R16, 0b01111110 //	0
	ST		X+,	R16		//	SE LE SUMA 1 AL PUNTERO

	LDI		R16, 0b00110000	//	1
	ST		X+,	R16 

	LDI		R16, 0b01101101	//	2
	ST		X+,	R16 

	LDI		R16, 0b01111001	//	3
	ST		X+,	R16 

	LDI		R16, 0b00110011	//	4
	ST		X+,	R16 

	LDI		R16, 0b01011011	//	5
	ST		X+,	R16 

	LDI		R16, 0b01011111	//	6
	ST		X+,	R16 

	LDI		R16, 0b01110000	//	7
	ST		X+,	R16 

	LDI		R16, 0b01111111	//	8
	ST		X+,	R16 

	LDI		R16, 0b01111011	//	9	
	ST		X+,	R16 



	LDI		XH, 0X01	//	PUNTERO X HACIA 0x0100
	LDI		XL, 0X00

	LDI		ZH, 0X01	//	PUNTERO Z HACIA 0x0100
	LDI		ZL, 0X00

	LD      DISPLAY, X     //Cargar el primer número (0) 
	OUT     PORTD, DISPLAY // Mostrar 0 en el display

	LD		DISPLAY2, Z

	//LD		DISPLAY2, Z
	

	LDI		R20, 0    // INICIALIZAR CONTADOR  DE LEDS EN 0
	LDI		R17, 0	  // INICIALIZAR CONTADOR DEL TIMER EN 0
	OUT		PORTC, R20 // APAGAR TODAS LAS LEDS

	LDI		R16, 0b00010000   ; Solo encender PC4 al inicio (Display 1)
	OUT		PORTC, R16


	SEI	// VOLVER A HABILITAR INTERRUPCIONES

MAIN_LOOP:

	CPI		R17, 250
	BRNE	MAIN_LOOP
	CLR		R17
	CALL    SUMAR1
	RJMP	MAIN_LOOP



// SUBRUTINAS SIN INTERRUPCION
// Subrutina para incrementar el contador
SUMAR1:
	CPI		DISPLAY, 0b01111011 // VERIFICAR SI HAY OVERFLOW EN EL DISPLAY (F)
    BREQ    OVERFLOW1
	LD		DISPLAY, X+		//INCREMENTAR UNA AL PUNTERO X
	LD		DISPLAY, X		//	GUARDAR EN DISPLAY LO QUE ESTA APUNTANDO EL PUNTERO
	   
	RET
OVERFLOW1:
    LDI		XH, 0x01
	LDI		XL, 0X00
	LD		DISPLAY, X

	CPI		DISPLAY2, 0b01011011 // VERIFICAR SI HAY OVERFLOW EN EL DISPLAY (5)
    BREQ    OVERFLOW2
	LD		DISPLAY2, Z+		//INCREMENTAR UNA AL PUNTERO X
	LD		DISPLAY2, Z		//	GUARDAR EN DISPLAY LO QUE ESTA APUNTANDO EL PUNTERO
	   
	RET
OVERFLOW2:
    LDI		ZH, 0x01
	LDI		ZL, 0X00

	LD		DISPLAY2, Z
	    
	RET 



// SUBRUTINAS DE INTERRUPCION

// CONTADOR DE LEDS
PCINT0_ISR:
	SBI PCIFR, PCIF0  ; Borra la bandera de interrupción

	// SE GUARDAN LOS VALORES  INICIALES EN EL MAIN
	PUSH	R16			// STORES CONTENTS OF R16 IN STACK
	IN		R16, SREG	// STORES SREG IN R16
	PUSH	R16			// SOTRES CONTENTES OF R16 IN STACK

// OPERACION DE INTERRUPCION
	IN		R16, PINB
	SBRC	R16,0     // Si PB0 fue presionado (LOW)
    RJMP	SALTAR

//SUMAR AL CONTADOR
	CPI     R20, 0b00001111
    BREQ    OVERFLOW
    INC     R20
    RJMP	SALTAR2
OVERFLOW:
    LDI     R20, 0x00
    RJMP	SALTAR2


SALTAR:
	SBRC	R16, 1		// SI PB1 NO FUE PRESIONADO 
	RJMP	SALTAR2

//RESTAR AL CONTADOR
    CPI     R20, 0x00
    BREQ    UNDERFLOW1
    DEC     R20
    RJMP	SALTAR2
UNDERFLOW1:
    LDI     R20, 0b00001111
	

SALTAR2:
	IN		R16, PORTC		; Leer el estado actual de PORTC
	ANDI	R16, 0b00110000	; Conservar solo los bits de multiplexado (PC4 y PC5)
	OR		R16, R20		; Combinar con el valor de R20 (manteniendo PC4 y PC5 intactos)
	OUT		PORTC, R16		; Escribir de nuevo en PORTC


	//	SE OBTIENEN LOS VALORES INICIALES QUE SE HICIERON EN EL MAIN
	POP		R16			// GETS CONTENTS FROM STACK TAKE THE LAST DATA
	OUT		SREG, R16	//
	POP		R16

	RETI


TIMR0_ISR:
	// SE GUARDAN LOS VALORES  INICIALES EN EL MAIN
	PUSH	R16	
	PUSH    R18		// STORES CONTENTS OF R16 IN STACK
	IN		R16, SREG	// STORES SREG IN R16
	PUSH	R16			// SOTRES CONTENTES OF R16 IN STACK

	// OPERACION DE INTERRUPCION
	// RECARGAR EL TIMER0
	LDI		R16, 178
	OUT		TCNT0, R16
	INC		R17

	// INICIA PARTE DE MULTIPLEXEAR

	// APAGAR SEGMENTOS ANTES DE CAMBIAR DISPLAY
	LDI		R16, 0x00
	OUT		PORTD, R16  ; Apagar display antes de cambiar

	
	IN		R16, PORTC ; Leer PORTC en vez de PINC

	// MOSTRAR EL NÚMERO CORRECTO
	SBRS	R16, 4       
	RJMP	CHECK_PC5
	OUT		PORTD, DISPLAY  

CHECK_PC5:
	SBRC	R16, 5       
	OUT		PORTD, DISPLAY2  

	// TOGGLE SOLO PC4 Y PC5
	LDI		R18, 0b00110000
	EOR		R16, R18
	OUT		PORTC, R16  


	//	SE OBTIENEN LOS VALORES INICIALES QUE SE HICIERON EN EL MAIN
	POP		R18
	POP		R16			// GETS CONTENTS FROM STACK TAKE THE LAST DATA
	OUT		SREG, R16	//
	POP		R16

	RETI





